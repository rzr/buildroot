## package/heimdal/Config.in
```kconfig
config BR2_PACKAGE_HEIMDAL
	bool "heimdal"
	depends on BR2_USE_MMU # fork()
	depends on BR2_LARGEFILE # e2fsprogs
	depends on BR2_USE_WCHAR # util-linux for e2fsprogs
	depends on BR2_TOOLCHAIN_HAS_THREADS
	depends on BR2_TOOLCHAIN_HAS_NATIVE_RPC # rresvport()
	select BR2_PACKAGE_E2FSPROGS
	select BR2_PACKAGE_NCURSES
	select BR2_PACKAGE_SQLITE
	help
	  Heimdal is an implementation of Kerberos 5 (and some more stuff).

	  http://www.h5l.org/

comment "heimdal needs a toolchain w/ RPC, wchar, largefile, threads"
	depends on !BR2_TOOLCHAIN_HAS_THREADS || !BR2_LARGEFILE || \
		!BR2_USE_WCHAR || !BR2_TOOLCHAIN_HAS_NATIVE_RPC
	depends on BR2_USE_MMU
```

## package/multi-role/Config.in
```kconfig
config BR2_PACKAGE_MULTI_ROLE
	bool "multi-role"
    depends on BR2_PACKAGE_PSKILL 
    depends on BR2_PACKAGE_WPA_SUPPLICANT
    depends on BR2_PACKAGE_HOSTAPD
    depends on BR2_PACKAGE_IPTABLES
    depends on BR2_PACKAGE_DHCP
	help
      Wifi Multi-role mode (STA+AP).
```

## package/paragon-ufsd/Config.in
```kconfig
config BR2_PACKAGE_PARAGON_UFSD
	bool "Paragon Kernel Module"
    depends on BR2_LINUX_KERNEL
	select BR2_PACKAGE_NCURSES
	help
      
```

## package/pmxpackage_filecache/Config.in
```kconfig
config BR2_PACKAGE_PMXPACKAGE_FILECACHE
	bool "pmxpackage(filecache)"
	help
	  The primax package(filecache) filecache  for Avatar device
```

## package/rxdsk/Config.in
```kconfig
config BR2_PACKAGE_RXDSK
	bool "rxdsk"
    depends on BR2_LINUX_KERNEL
	help
        An open source enhanced Linux RAM disk module 
```
